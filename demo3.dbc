VERSION ""

NS_ :

BS_:

BU_:

BO_ 1810A7F3 MotorController1: 8 Vector_XXX
 SG_ MotorSpeed : 0|16@1+ (0.1,0) [0|10000] "rpm" Vector_XXX
 SG_ MotorTorque : 16|16@1+ (0.1,0) [0|500] "Nm" Vector_XXX
 SG_ MotorTemperature : 32|16@1+ (1,0) [-40|210] "°C" Vector_XXX

BO_ 1818A7F3 MotorController2: 8 Vector_XXX
 SG_ MotorSpeed2 : 0|16@1+ (0.1,0) [0|10000] "rpm" Vector_XXX
 SG_ MotorTorque2 : 16|16@1+ (0.1,0) [0|500] "Nm" Vector_XXX
 SG_ InverterTemperature : 32|16@1+ (1,0) [-40|210] "°C" Vector_XXX

BO_ 1801F3A7 BatteryManagement1: 8 Vector_XXX
 SG_ BatteryVoltage : 0|16@1+ (0.1,0) [0|6553.5] "V" Vector_XXX
 SG_ BatteryCurrent : 16|16@1+ (0.1,0) [-3276.8|3276.7] "A" Vector_XXX
 SG_ StateOfCharge : 32|8@1+ (0.4,0) [0|100] "%" Vector_XXX
 SG_ BatteryTemperature : 40|16@1+ (1,0) [-40|100] "°C" Vector_XXX

BO_ 18500627 VehicleStatus1: 8 Vector_XXX
 SG_ VehicleSpeed : 8|16@1+ (0.00390625,0) [0|250.996] "km/h" Vector_XXX
 SG_ Odometer : 24|32@1+ (1,0) [0|4294967295] "km" Vector_XXX
 SG_ TirePressureFL : 0|8@1+ (0.1,0) [0|100] "psi" Vector_XXX
 SG_ TirePressureFR : 8|8@1+ (0.1,0) [0|100] "psi" Vector_XXX

BO_ 18FF0527 BatteryManagement2: 8 Vector_XXX
 SG_ BatteryVoltage2 : 0|16@1+ (0.1,0) [0|6553.5] "V" Vector_XXX
 SG_ BatteryCurrent2 : 16|16@1+ (0.1,0) [-3276.8|3276.7] "A" Vector_XXX

BO_ 18FF0927 BatteryManagement3: 8 Vector_XXX
 SG_ StateOfCharge2 : 32|8@1+ (0.4,0) [0|100] "%" Vector_XXX
 SG_ BatteryTemperature2 : 40|16@1+ (1,0) [-40|100] "°C" Vector_XXX

BO_ 1804A7F3 MotorController3: 8 Vector_XXX
 SG_ MotorSpeed3 : 0|16@1+ (0.1,0) [0|10000] "rpm" Vector_XXX
 SG_ MotorTemperature3 : 16|16@1+ (1,0) [-40|210] "°C" Vector_XXX

BO_ 1805A7F3 MotorController4: 8 Vector_XXX
 SG_ MotorTorque3 : 0|16@1+ (0.1,0) [0|500] "Nm" Vector_XXX

BO_ 1806A7F3 InverterController1: 8 Vector_XXX
 SG_ InverterTemperature1 : 0|16@1+ (1,0) [-40|210] "°C" Vector_XXX

BO_ 1807A7F3 InverterController2: 8 Vector_XXX
 SG_ InverterTemperature2 : 0|16@1+ (1,0) [-40|210] "°C" Vector_XXX

CM_ BO_ 1810A7F3 "Motor Controller 1 Data";
CM_ SG_ 1810A7F3 MotorSpeed "Actual motor speed in revolutions per minute";
CM_ SG_ 1810A7F3 MotorTorque "Motor torque in Nm";
CM_ SG_ 1810A7F3 MotorTemperature "Motor temperature in degrees Celsius";

CM_ BO_ 1818A7F3 "Motor Controller 2 Data";
CM_ SG_ 1818A7F3 MotorSpeed2 "Actual motor speed in revolutions per minute";
CM_ SG_ 1818A7F3 MotorTorque2 "Motor torque in Nm";
CM_ SG_ 1818A7F3 InverterTemperature "Temperature of the inverter in degrees Celsius";

CM_ BO_ 1801F3A7 "Battery Management 1 Data";
CM_ SG_ 1801F3A7 BatteryVoltage "Voltage of the battery pack in volts";
CM_ SG_ 1801F3A7 BatteryCurrent "Current of the battery pack in amperes";
CM_ SG_ 1801F3A7 StateOfCharge "State of charge of the battery pack in percentage";
CM_ SG_ 1801F3A7 BatteryTemperature "Temperature of the battery in degrees Celsius";

CM_ BO_ 18500627 "Vehicle Status 1 Data";
CM_ SG_ 18500627 VehicleSpeed "Vehicle speed in kilometers per hour";
CM_ SG_ 18500627 Odometer "Odometer reading in kilometers";
CM_ SG_ 18500627 TirePressureFL "Tire pressure of front left tire in psi";
CM_ SG_ 18500627 TirePressureFR "Tire pressure of front right tire in psi";

BA_DEF_ SG_ "SPN" INT 0 524287;
BA_DEF_ BO_ "VFrameFormat" ENUM "StandardCAN","ExtendedCAN","reserved","J1939PG";
BA_DEF_ "BusType" STRING;
BA_DEF_ "ProtocolType" STRING;
BA_DEF_DEF_ "SPN" 0;
BA_DEF_DEF_ "VFrameFormat" "J1939PG";
BA_DEF_DEF_ "BusType" "";
BA_DEF_DEF_ "ProtocolType" "";
BA_ "ProtocolType" "J1939";
BA_ "BusType" "CAN";
BA_ "SPN" SG_ 1810A7F3 MotorSpeed 1001;
BA_ "SPN" SG_ 1810A7F3 MotorTorque 1002;
BA_ "SPN" SG_ 1810A7F3 MotorTemperature 1003;
BA_ "SPN" SG_ 18500627 VehicleSpeed 1101;
BA_ "SPN" SG_ 1801F3A7 BatteryVoltage 2001;
BA_ "SPN" SG_ 1801F3A7 BatteryCurrent 2002;
BA_ "SPN" SG_ 1801F3A7 StateOfCharge 2003;
BA_ "SPN" SG_ 18500627 TirePressureFL 1102;
BA_ "SPN" SG_ 18500627 TirePressureFR 1103;
